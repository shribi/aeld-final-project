## br2-external/Config.in
```kconfig
source "$BR2_EXTERNAL_INMP_PATH/package/inmp-module/Config.in"
source "$BR2_EXTERNAL_INMP_PATH/package/inmp-test/Config.in"
```

## br2-external/package/inmp-module/Config.in
```kconfig
config BR2_PACKAGE_INMP_MODULE
	bool "inmp-module"
	depends on BR2_LINUX_KERNEL
	select BR2_PACKAGE_UTIL_LINUX
	select BR2_PACKAGE_UTIL_LINUX_BINARIES
	help
	  INMP441 line discipline kernel module (N_DEVELOPMENT, 29).
	  Decodes framed PCM from an ESP32 on a serial port. Attach with:
	  ldattach -s 921600 29 /dev/ttyUSB0

	  ldattach is provided by util-linux binaries, which this option
	  selects.

comment "inmp-module needs a Linux kernel to be built"
	depends on !BR2_LINUX_KERNEL
```

## br2-external/package/inmp-test/Config.in
```kconfig
config BR2_PACKAGE_INMP_TEST
	bool "inmp-test"
	help
	  Userspace client that records INMP441 PCM from a serial port
	  (or from the inmp-module line discipline with -l) into a WAV file.
```
